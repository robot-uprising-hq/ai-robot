## components/motor_control/Kconfig.projbuild
```kconfig
menu "MicroInvaders motor config"
config MC_DEFAULT_PWM_FREQ
    int "Default PWM frequency"
    default 1000
    help
    	Default PWM frequency to use in motor control.

config MC_DEFAULT_HARD_TIMEOUT
    int "Default hard timeout"
    default 3000
    help
    	Default hard timeout for motor actions, in milliseconds.

endmenu
```

## components/udpcomm/Kconfig.projbuild
```kconfig
menu "MicroInvaders UDP server"
config UDP_LED_ACTIVITY_TIME
    int "LED activity period (ms)"
    default 200
    help
    	How long should LED stay active after receiving a network packet, in milliseconds.

endmenu
```

## components/wifi/Kconfig.projbuild
```kconfig
menu "MicroInvaders WiFi"
config WIFI_SSID
    string "WiFi SSID"
    help
    	SSID (network name) for the example to connect to.

config WIFI_PASSWORD
    string "WiFi Password"
    help
	    WiFi password (WPA or WPA2) for the example to use.

config WIFI_SCAN_LIST_SIZE
    int "Max size of scan list"
    range 0 20
    default 10
    help
        The size of array that will be used to retrieve the list of access points.

config WIFI_MAXIMUM_RETRY
    int "Maximum retry"
    default 5
    help
        Set the Maximum retry to avoid station reconnecting to the AP unlimited when the AP is really inexistent.

endmenu
```
